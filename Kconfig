## Kconfig
```kconfig
menu "mongoose library support"

config ZEROMQ
	bool "mongoose web library"

if ZEROMQ

# config MONGOOSE_VERBOSE
# 	bool "Make zcbor code print messages"

# config MONGOOSE_ENABLE_PACKED_FS
# 	bool "enabled packed filesystem"
# 	default y

endif #MONGOOSE

endmenu
```
